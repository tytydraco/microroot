## microroot_defconfig
```kconfig
BR2_x86_64=y
BR2_x86_corei7=y
BR2_CCACHE=y
BR2_REPRODUCIBLE=y
BR2_TOOLCHAIN_BUILDROOT_GLIBC=y
BR2_KERNEL_HEADERS_4_4=y
BR2_BINUTILS_VERSION_2_34_X=y
BR2_GCC_VERSION_10_X=y
BR2_GCC_ENABLE_LTO=y
BR2_GCC_ENABLE_GRAPHITE=y
BR2_TARGET_GENERIC_HOSTNAME="microroot"
BR2_TARGET_GENERIC_ISSUE="--- MicroRoot ---"
BR2_TARGET_ROOTFS_TAR_XZ=y
```
